#include <Arduino.h>
#include <Wire.h>

// Low-region patch bundle generated by TI tool (I2Ct patch burst data).
// The .c file should live next to this .ino and will be compiled separately.
extern const char tps25750x_lowRegion_i2c_array[];
extern int gSizeLowRegionArray;

// ---------------- User configuration ----------------
// I2C pins (ESP32 default is SDA=21, SCL=22). Override if needed.
static const int I2C_SDA_PIN = 21;
static const int I2C_SCL_PIN = 22;
static const uint32_t I2C_CLOCK_HZ = 400000;

// BQ25792 fixed 7-bit I2C address per datasheet.
static const uint8_t BQ25792_ADDR = 0x6B;

// TPS25751 I2C target address depends on ADCIN1/2 strap (0x20-0x23).
// Set AUTO_DETECT_TPS25751 = true to probe 0x20..0x23 and use the first found.
static const uint8_t TPS25751_DEFAULT_ADDR = 0x22;
static const bool AUTO_DETECT_TPS25751 = true;
static const uint8_t TPS25751_ADDR_CANDIDATES[] = {0x20, 0x21, 0x22, 0x23};

// Poll interval
static const uint32_t POLL_INTERVAL_MS = 1000;

// Optional I2C scan and EEPROM probe (on the bus you are connected to).
static const bool ENABLE_I2C_SCAN = true;
static const uint8_t EEPROM_ADDR = 0x50;
static const bool PROBE_EEPROM = true;
static const uint16_t EEPROM_PROBE_ADDR = 0x0000;
static const uint8_t EEPROM_PROBE_LEN = 16;

// Low-region patch provisioning over I2Ct (Patch Burst Mode).
static const bool ENABLE_LOW_REGION_PROVISION = true;
static const bool PROVISION_ON_BOOT = false;
static const uint8_t PATCH_TARGET_ADDR = 0x30; // Must not conflict with any I2Ct target.
static const uint8_t PATCH_TIMEOUT_100MS = 0x32; // 0x32 = 5 seconds.
static const uint8_t PATCH_CHUNK_BYTES = 32;
// ----------------------------------------------------

static uint8_t tpsAddr = TPS25751_DEFAULT_ADDR;
static bool tpsPresent = false;
static bool bqPresent = false;
static bool printTpsUpdates = false;
static bool printBqUpdates = false;
static uint32_t lastI2CrMs = 0;

static const uint8_t *const LOW_REGION_DATA =
    reinterpret_cast<const uint8_t *>(tps25750x_lowRegion_i2c_array);
static const size_t LOW_REGION_SIZE = (size_t)gSizeLowRegionArray;

static void printHexBytes(const uint8_t *buf, size_t len) {
  for (size_t i = 0; i < len; ++i) {
    if (i > 0) {
      Serial.print(' ');
    }
    if (buf[i] < 0x10) {
      Serial.print('0');
    }
    Serial.print(buf[i], HEX);
  }
}

static bool probeAddress(uint8_t addr) {
  Wire.beginTransmission(addr);
  return Wire.endTransmission() == 0;
}

static void scanI2CBus() {
  Serial.println("I2C scan:");
  bool any = false;
  for (uint8_t addr = 0x03; addr <= 0x77; ++addr) {
    if (probeAddress(addr)) {
      Serial.printf("  - 0x%02X\n", addr);
      any = true;
    }
  }
  if (!any) {
    Serial.println("  (no devices found)");
  }
}

static bool readEepromBytes(uint8_t addr, uint16_t memAddr, uint8_t *out, size_t len) {
  Wire.beginTransmission(addr);
  Wire.write((uint8_t)(memAddr >> 8));
  Wire.write((uint8_t)(memAddr & 0xFF));
  if (Wire.endTransmission(false) != 0) {
    return false;
  }
  if (Wire.requestFrom((int)addr, (int)len) != (int)len) {
    return false;
  }
  for (size_t i = 0; i < len; ++i) {
    out[i] = Wire.read();
  }
  return true;
}

static bool readBqReg(uint8_t reg, uint8_t &value) {
  Wire.beginTransmission(BQ25792_ADDR);
  Wire.write(reg);
  if (Wire.endTransmission(false) != 0) {
    return false;
  }
  if (Wire.requestFrom((int)BQ25792_ADDR, 1) != 1) {
    return false;
  }
  value = Wire.read();
  return true;
}

static bool writeBqReg(uint8_t reg, uint8_t value) {
  Wire.beginTransmission(BQ25792_ADDR);
  Wire.write(reg);
  Wire.write(value);
  return Wire.endTransmission() == 0;
}

static bool readBqReg16(uint8_t reg, uint16_t &value) {
  Wire.beginTransmission(BQ25792_ADDR);
  Wire.write(reg);
  if (Wire.endTransmission(false) != 0) {
    return false;
  }
  if (Wire.requestFrom((int)BQ25792_ADDR, 2) != 2) {
    return false;
  }
  uint8_t lo = Wire.read();
  uint8_t hi = Wire.read();
  value = (uint16_t)lo | ((uint16_t)hi << 8);
  return true;
}

static bool enableBqAdc() {
  uint8_t reg2e = 0;
  uint8_t reg2f = 0;
  uint8_t reg30 = 0;
  if (!readBqReg(0x2E, reg2e) ||
      !readBqReg(0x2F, reg2f) ||
      !readBqReg(0x30, reg30)) {
    return false;
  }

  // ADC_EN=1, ADC_RATE=0 (continuous), ADC_SAMPLE=00 (15-bit), ADC_AVG=0.
  reg2e &= ~(0x7F);
  reg2e |= 0x80;

  // Ensure ADC channels we care about are enabled (clear disable bits).
  reg2f &= ~(0xF8); // IBUS/IBAT/VBUS/VBAT/VSYS enable.
  reg30 &= ~(0x30); // VAC1/VAC2 enable.

  if (!writeBqReg(0x2E, reg2e) ||
      !writeBqReg(0x2F, reg2f) ||
      !writeBqReg(0x30, reg30)) {
    return false;
  }
  return true;
}

static bool readTpsRegister(uint8_t reg, uint8_t *buf, size_t expectedLen,
                            uint8_t &actualLen) {
  Wire.beginTransmission(tpsAddr);
  Wire.write(reg);
  if (Wire.endTransmission(false) != 0) {
    return false;
  }

  const size_t toRead = 1 + expectedLen;
  size_t got = Wire.requestFrom((int)tpsAddr, (int)toRead);
  if (got < 1) {
    return false;
  }

  uint8_t count = Wire.read();
  actualLen = (count < expectedLen) ? count : expectedLen;
  for (uint8_t i = 0; i < actualLen; ++i) {
    if (!Wire.available()) {
      return false;
    }
    buf[i] = Wire.read();
  }

  while (Wire.available()) {
    Wire.read();
  }

  return true;
}

static bool readTpsRegisterRaw(uint8_t reg, uint8_t *buf, size_t len) {
  Wire.beginTransmission(tpsAddr);
  Wire.write(reg);
  if (Wire.endTransmission(false) != 0) {
    return false;
  }
  size_t got = Wire.requestFrom((int)tpsAddr, (int)len);
  if (got != len) {
    return false;
  }
  for (size_t i = 0; i < len; ++i) {
    buf[i] = Wire.read();
  }
  return true;
}

static bool readBqStatusViaTps(uint8_t *regs, size_t len) {
  if (!tpsPresent) {
    Serial.println("BQ via TPS: TPS25751 not detected.");
    return false;
  }
  if (len == 0) {
    return false;
  }
  uint32_t now = millis();
  if (now - lastI2CrMs < 5000) {
    Serial.printf("BQ via TPS: wait %lu ms before next I2Cr\n",
                  (unsigned long)(5000 - (now - lastI2CrMs)));
    return false;
  }

  uint8_t data1[3] = {0};
  data1[0] = BQ25792_ADDR & 0x7F;
  data1[1] = 0x1B;
  data1[2] = (uint8_t)len;
  if (!writeTpsData1(data1, sizeof(data1))) {
    Serial.println("BQ via TPS: DATA1 write failed");
    return false;
  }
  if (!writeTpsCmd4cc("I2Cr")) {
    Serial.println("BQ via TPS: CMD1 write failed");
    return false;
  }
  if (!waitTpsCmdComplete(6000)) {
    Serial.println("BQ via TPS: CMD1 did not complete");
    return false;
  }

  uint8_t out[1 + 16] = {0};
  if (!readTpsData1(out, 1 + len)) {
    Serial.println("BQ via TPS: DATA1 read failed");
    return false;
  }
  uint8_t rc = out[0];
  if (rc != 0x00) {
    Serial.printf("BQ via TPS: return code 0x%02X\n", rc);
    return false;
  }

  memcpy(regs, out + 1, len);
  lastI2CrMs = now;
  return true;
}

static void printBqStatusFromRegs(const uint8_t *regs, size_t len) {
  if (len < 7) {
    Serial.println("BQ25792: insufficient data");
    return;
  }
  uint8_t reg1b = regs[0];
  uint8_t reg1c = regs[1];
  uint8_t reg1d = regs[2];
  uint8_t reg1e = regs[3];
  uint8_t reg1f = regs[4];
  uint8_t reg20 = regs[5];
  uint8_t reg21 = regs[6];

  Serial.println("BQ25792:");
  Serial.printf("  REG1B Status0: 0x%02X\n", reg1b);
  Serial.printf("    VBUS_PRESENT=%u AC1_PRESENT=%u AC2_PRESENT=%u PG=%u POORSRC=%u WD=%u VINDPM=%u IINDPM=%u\n",
                reg1b & 0x01, (reg1b >> 1) & 0x01, (reg1b >> 2) & 0x01, (reg1b >> 3) & 0x01,
                (reg1b >> 4) & 0x01, (reg1b >> 5) & 0x01, (reg1b >> 6) & 0x01, (reg1b >> 7) & 0x01);

  Serial.printf("  REG1C Status1: 0x%02X\n", reg1c);
  Serial.printf("    CHG_STAT=%s VBUS_STAT=%s BC1.2_DONE=%u\n",
                bqChgStatStr((reg1c >> 5) & 0x07),
                bqVbusStatStr((reg1c >> 1) & 0x0F),
                reg1c & 0x01);

  Serial.printf("  REG1D Status2: 0x%02X\n", reg1d);
  Serial.printf("    ICO=%s TREG=%u DPDM=%u VBAT_PRESENT=%u\n",
                bqIcoStatStr((reg1d >> 6) & 0x03),
                (reg1d >> 2) & 0x01,
                (reg1d >> 1) & 0x01,
                reg1d & 0x01);

  Serial.printf("  REG1E Status3: 0x%02X\n", reg1e);
  Serial.printf("    ACRB2=%u ACRB1=%u ADC_DONE=%u VSYS_STAT=%u CHG_TMR=%u TRICHG_TMR=%u PRECHG_TMR=%u\n",
                (reg1e >> 7) & 0x01, (reg1e >> 6) & 0x01, (reg1e >> 5) & 0x01, (reg1e >> 4) & 0x01,
                (reg1e >> 3) & 0x01, (reg1e >> 2) & 0x01, (reg1e >> 1) & 0x01);

  Serial.printf("  REG1F Status4: 0x%02X\n", reg1f);
  Serial.printf("    VBATOTG_LOW=%u TS_COLD=%u TS_COOL=%u TS_WARM=%u TS_HOT=%u\n",
                (reg1f >> 4) & 0x01, (reg1f >> 3) & 0x01, (reg1f >> 2) & 0x01,
                (reg1f >> 1) & 0x01, reg1f & 0x01);

  Serial.printf("  REG20 Fault0: 0x%02X\n", reg20);
  Serial.printf("    IBAT_REG=%u VBUS_OVP=%u VBAT_OVP=%u IBUS_OCP=%u IBAT_OCP=%u CONV_OCP=%u VAC2_OVP=%u VAC1_OVP=%u\n",
                (reg20 >> 7) & 0x01, (reg20 >> 6) & 0x01, (reg20 >> 5) & 0x01, (reg20 >> 4) & 0x01,
                (reg20 >> 3) & 0x01, (reg20 >> 2) & 0x01, (reg20 >> 1) & 0x01, reg20 & 0x01);

  Serial.printf("  REG21 Fault1: 0x%02X\n", reg21);
  Serial.printf("    VSYS_SHORT=%u VSYS_OVP=%u OTG_OVP=%u OTG_UVP=%u TSHUT=%u\n",
                (reg21 >> 7) & 0x01, (reg21 >> 6) & 0x01, (reg21 >> 5) & 0x01,
                (reg21 >> 4) & 0x01, (reg21 >> 2) & 0x01);
}

static bool writeTpsRegister(uint8_t reg, const uint8_t *data, size_t len) {
  if (len > 255) {
    return false;
  }
  Wire.beginTransmission(tpsAddr);
  Wire.write(reg);
  Wire.write((uint8_t)len);
  Wire.write(data, len);
  return Wire.endTransmission() == 0;
}

static bool readTpsCmd(uint8_t out[4]) {
  uint8_t actual = 0;
  if (!readTpsRegister(0x08, out, 4, actual) || actual < 4) {
    return false;
  }
  return true;
}

static bool tpsCmdIsZero(const uint8_t cmd[4]) {
  return cmd[0] == 0 && cmd[1] == 0 && cmd[2] == 0 && cmd[3] == 0;
}

static bool tpsCmdIsBangCmd(const uint8_t cmd[4]) {
  return cmd[0] == '!' && cmd[1] == 'C' && cmd[2] == 'M' && cmd[3] == 'D';
}

static bool waitTpsCmdComplete(uint32_t timeoutMs) {
  uint32_t start = millis();
  uint8_t cmd[4] = {0};
  while (millis() - start < timeoutMs) {
    if (!readTpsCmd(cmd)) {
      return false;
    }
    if (tpsCmdIsZero(cmd)) {
      return true;
    }
    if (tpsCmdIsBangCmd(cmd)) {
      return false;
    }
    delay(10);
  }
  return false;
}

static bool writeTpsCmd4cc(const char cmd[4]) {
  return writeTpsRegister(0x08, (const uint8_t *)cmd, 4);
}

static bool writeTpsData1(const uint8_t *data, size_t len) {
  return writeTpsRegister(0x09, data, len);
}

static bool readTpsData1(uint8_t *out, size_t len) {
  uint8_t actual = 0;
  if (!readTpsRegister(0x09, out, len, actual) || actual < len) {
    return false;
  }
  return true;
}

static bool tpsStartPatchBurst(uint32_t bundleSize, uint8_t patchTarget) {
  uint8_t data1[7] = {0};
  data1[0] = (uint8_t)(bundleSize & 0xFF);
  data1[1] = (uint8_t)((bundleSize >> 8) & 0xFF);
  data1[2] = (uint8_t)((bundleSize >> 16) & 0xFF);
  data1[3] = (uint8_t)((bundleSize >> 24) & 0xFF);
  data1[5] = patchTarget & 0x7F;
  data1[6] = PATCH_TIMEOUT_100MS & 0x3F;

  if (!writeTpsData1(data1, sizeof(data1))) {
    Serial.println("PBMs: DATA1 write failed");
    return false;
  }
  if (!writeTpsCmd4cc("PBMs")) {
    Serial.println("PBMs: CMD1 write failed");
    return false;
  }
  if (!waitTpsCmdComplete(2000)) {
    Serial.println("PBMs: CMD1 did not complete");
    return false;
  }

  uint8_t out[8] = {0};
  if (!readTpsData1(out, sizeof(out))) {
    Serial.println("PBMs: DATA1 read failed");
    return false;
  }
  uint8_t status = out[0];
  Serial.printf("PBMs status: 0x%02X\n", status);
  return status == 0x00;
}

static bool tpsCompletePatchBurst() {
  if (!writeTpsCmd4cc("PBMc")) {
    Serial.println("PBMc: CMD1 write failed");
    return false;
  }
  if (!waitTpsCmdComplete(5000)) {
    Serial.println("PBMc: CMD1 did not complete");
    return false;
  }

  uint8_t out[16] = {0};
  if (!readTpsData1(out, sizeof(out))) {
    Serial.println("PBMc: DATA1 read failed");
    return false;
  }

  uint8_t taskReturn = out[0];
  uint8_t devicePatchStatus = out[2];
  uint8_t appConfigStatus = out[3];
  Serial.printf("PBMc return: 0x%02X devicePatch=0x%02X appConfig=0x%02X\n",
                taskReturn, devicePatchStatus, appConfigStatus);
  return devicePatchStatus == 0x00;
}

static bool sendPatchBurstData(const uint8_t *data, size_t len, uint8_t patchTarget) {
  size_t offset = 0;
  while (offset < len) {
    size_t chunk = len - offset;
    if (chunk > PATCH_CHUNK_BYTES) {
      chunk = PATCH_CHUNK_BYTES;
    }
    Wire.beginTransmission(patchTarget);
    Wire.write(data + offset, chunk);
    if (Wire.endTransmission() != 0) {
      Serial.printf("Patch burst NACK at offset %u\n", (unsigned int)offset);
      return false;
    }
    offset += chunk;
    if ((offset % 1024) == 0) {
      Serial.printf("Patch burst: %u/%u bytes\n",
                    (unsigned int)offset, (unsigned int)len);
    }
    delay(2);
  }
  return true;
}

static void provisionLowRegionPatch() {
  if (!tpsPresent) {
    Serial.println("Provision: TPS25751 not detected.");
    return;
  }
  if (PATCH_TARGET_ADDR == tpsAddr) {
    Serial.println("Provision: PATCH_TARGET_ADDR conflicts with TPS I2Ct address.");
    return;
  }
  if (probeAddress(PATCH_TARGET_ADDR)) {
    Serial.printf("Provision: PATCH_TARGET_ADDR 0x%02X already in use.\n", PATCH_TARGET_ADDR);
    return;
  }

  uint8_t mode[4] = {0};
  uint8_t actual = 0;
  if (!readTpsRegister(0x03, mode, 4, actual) || actual < 4) {
    Serial.println("Provision: failed to read MODE.");
    return;
  }
  if (memcmp(mode, "APP ", 4) == 0) {
    Serial.println("Provision: TPS is in APP mode; PBMs will be rejected.");
    return;
  }

  Serial.printf("Provision: sending low-region bundle (%u bytes) to 0x%02X\n",
                (unsigned int)LOW_REGION_SIZE, PATCH_TARGET_ADDR);

  if (!tpsStartPatchBurst((uint32_t)LOW_REGION_SIZE, PATCH_TARGET_ADDR)) {
    Serial.println("Provision: PBMs failed.");
    return;
  }
  if (!sendPatchBurstData(LOW_REGION_DATA, LOW_REGION_SIZE, PATCH_TARGET_ADDR)) {
    Serial.println("Provision: burst write failed.");
    return;
  }
  if (!tpsCompletePatchBurst()) {
    Serial.println("Provision: PBMc reported failure.");
    return;
  }
  Serial.println("Provision: low-region patch complete.");
}

static uint64_t leBytesToU64(const uint8_t *buf, size_t len) {
  uint64_t value = 0;
  for (size_t i = 0; i < len; ++i) {
    value |= ((uint64_t)buf[i]) << (8 * i);
  }
  return value;
}

static const char *bqChgStatStr(uint8_t v) {
  switch (v) {
    case 0: return "Not Charging";
    case 1: return "Trickle";
    case 2: return "Pre-charge";
    case 3: return "Fast charge (CC)";
    case 4: return "Taper charge (CV)";
    case 6: return "Top-off timer active";
    case 7: return "Charge termination";
    default: return "Reserved";
  }
}

static const char *bqVbusStatStr(uint8_t v) {
  static const char *const table[16] = {
    "No input / BHOT / BCOLD",
    "USB SDP (500mA)",
    "USB CDP (1.5A)",
    "USB DCP (3.25A)",
    "HVDCP (1.5A)",
    "Unknown adaptor (3A)",
    "Non-standard adaptor",
    "OTG mode",
    "Not qualified adaptor",
    "Reserved",
    "Reserved",
    "Directly powered from VBUS",
    "Reserved",
    "Reserved",
    "Reserved",
    "Reserved"
  };
  return table[v & 0x0F];
}

static const char *bqIcoStatStr(uint8_t v) {
  switch (v) {
    case 0: return "ICO disabled";
    case 1: return "ICO in progress";
    case 2: return "Max input current detected";
    default: return "Reserved";
  }
}

static const char *tpsConnStateStr(uint8_t v) {
  switch (v) {
    case 0: return "No connection";
    case 1: return "Port disabled";
    case 2: return "Audio accessory";
    case 3: return "Debug accessory";
    case 4: return "Ra only (no Rd)";
    case 6: return "Connection present (no Ra)";
    case 7: return "Connection present (Ra)";
    default: return "Reserved";
  }
}

static const char *tpsVbusStatusStr(uint8_t v) {
  switch (v) {
    case 0: return "vSafe0V";
    case 1: return "vSafe5V";
    case 2: return "Within expected limits";
    default: return "Out of range";
  }
}

static const char *tpsUsbHostStr(uint8_t v) {
  switch (v) {
    case 0: return "No host";
    case 1: return "Host not data capable";
    case 2: return "Host not USB PD capable";
    case 3: return "Host present";
    default: return "Unknown";
  }
}

static const char *tpsLegacyStr(uint8_t v) {
  switch (v) {
    case 0: return "Not legacy";
    case 1: return "Legacy sink";
    case 2: return "Legacy source";
    case 3: return "Legacy sink (dead-battery)";
    default: return "Unknown";
  }
}

static const char *tpsTypecCurrentStr(uint8_t v) {
  switch (v) {
    case 0: return "USB default";
    case 1: return "1.5 A";
    case 2: return "3.0 A";
    case 3: return "PD contract current";
    default: return "Unknown";
  }
}

static const char *tpsPortTypeStr(uint8_t v) {
  switch (v) {
    case 0: return "Sink/Source";
    case 1: return "Sink";
    case 2: return "Source";
    case 3: return "Source/Sink";
    default: return "Unknown";
  }
}

static const char *tpsCcPullupStr(uint8_t v) {
  switch (v) {
    case 0: return "No pull-up";
    case 1: return "USB default";
    case 2: return "1.5 A";
    case 3: return "3.0 A";
    default: return "Unknown";
  }
}

static const char *tpsTypecPortStateStr(uint8_t v) {
  switch (v) {
    case 0x00: return "Disabled";
    case 0x05: return "ErrorRecovery";
    case 0x24: return "Unattached.Accessory";
    case 0x2B: return "AttachWait.Accessory";
    case 0x45: return "Try.SRC";
    case 0x4E: return "TryWait.SNK";
    case 0x4F: return "Try.SNK";
    case 0x50: return "TryWait.SRC";
    case 0x60: return "Attached.SRC";
    case 0x61: return "Attached.SNK";
    case 0x62: return "AudioAccessory";
    case 0x63: return "DebugAccessory";
    case 0x64: return "AttachWait.SRC";
    case 0x65: return "AttachWait.SNK";
    case 0x66: return "Unattached.SNK";
    case 0x67: return "Unattached.SRC";
    default: return "Unknown";
  }
}

static const char *tpsCcPinStateStr(uint8_t v) {
  switch (v) {
    case 0: return "Not connected";
    case 1: return "Ra detected";
    case 2: return "Rd detected";
    case 3: return "USB default advert";
    case 4: return "1.5A advert";
    case 5: return "3.0A advert";
    default: return "Unknown";
  }
}

static const char *tpsPdCcPinStr(uint8_t v) {
  switch (v) {
    case 0: return "Not connected";
    case 1: return "CC1";
    case 2: return "CC2";
    default: return "Unknown";
  }
}

static const char *tpsHardResetStr(uint8_t v) {
  switch (v) {
    case 0x00: return "None";
    case 0x01: return "Received from partner";
    case 0x02: return "Requested by host";
    case 0x03: return "Invalid DR_Swap";
    case 0x04: return "DischargeFailed";
    case 0x05: return "NoResponseTimeout";
    case 0x06: return "SendSoftReset";
    case 0x07: return "Sink_SelectCapability";
    case 0x08: return "Sink_TransitionSink";
    case 0x09: return "Sink_WaitForCapabilities";
    case 0x0A: return "SoftReset";
    case 0x0B: return "SourceOnTimeout";
    case 0x0C: return "Source_CapabilityResponse";
    case 0x0D: return "Source_SendCapabilities";
    case 0x0E: return "SourcingFault";
    case 0x0F: return "UnableToSource";
    case 0x10: return "FRS failure";
    case 0x11: return "Unexpected message";
    case 0x12: return "VCONN recovery timeout";
    default: return "Unknown";
  }
}

static const char *tpsSoftResetStr(uint8_t v) {
  switch (v) {
    case 0x00: return "None";
    case 0x01: return "Received from partner";
    case 0x04: return "Invalid source caps";
    case 0x05: return "Message retries exhausted";
    case 0x06: return "Unexpected accept";
    case 0x07: return "Unexpected control msg";
    case 0x08: return "Unexpected GetSinkCap";
    case 0x09: return "Unexpected GetSourceCap";
    case 0x0A: return "Unexpected GotoMin";
    case 0x0B: return "Unexpected PS_RDY";
    case 0x0C: return "Unexpected Ping";
    case 0x0D: return "Unexpected Reject";
    case 0x0E: return "Unexpected Request";
    case 0x0F: return "Unexpected Sink Caps";
    case 0x10: return "Unexpected Source Caps";
    case 0x11: return "Unexpected Swap";
    case 0x12: return "Unexpected Wait Caps";
    case 0x13: return "Unknown control msg";
    case 0x14: return "Unknown data msg";
    case 0x15: return "Init SOP'";
    case 0x16: return "Init SOP''";
    case 0x17: return "Unexpected Extended";
    case 0x18: return "Unknown Extended";
    case 0x19: return "Unexpected data msg";
    case 0x1A: return "Unexpected Not Supported";
    case 0x1B: return "Unexpected Get_Status";
    default: return "Reserved";
  }
}

static void printTpsBootFlags() {
  uint8_t buf[8] = {0};
  uint8_t actual = 0;
  if (!readTpsRegister(0x2D, buf, 5, actual) || actual < 5) {
    Serial.println("  BOOT_FLAGS: read error");
    return;
  }

  uint64_t flags = leBytesToU64(buf, 5);
  uint8_t patchSource = (flags >> 29) & 0x07;
  uint8_t revisionId = (flags >> 32) & 0xFF;

  const char *patchSourceStr = "Unknown";
  switch (patchSource) {
    case 0x00: patchSourceStr = "None"; break;
    case 0x05: patchSourceStr = "EEPROM"; break;
    case 0x06: patchSourceStr = "I2C"; break;
    default: patchSourceStr = "Reserved"; break;
  }

  Serial.print("  BOOT_FLAGS: ");
  printHexBytes(buf, 5);
  Serial.println();
  Serial.printf("    RevisionID=0x%02X PatchSource=%s\n", revisionId, patchSourceStr);
  Serial.printf("    EEPROM_Present=%u Region0_Attempted=%u Region1_Attempted=%u\n",
                (uint8_t)((flags >> 3) & 0x01),
                (uint8_t)((flags >> 4) & 0x01),
                (uint8_t)((flags >> 5) & 0x01));
  Serial.printf("    Region0_Invalid=%u Region1_Invalid=%u Region0_EEPROM_Err=%u Region1_EEPROM_Err=%u\n",
                (uint8_t)((flags >> 6) & 0x01),
                (uint8_t)((flags >> 7) & 0x01),
                (uint8_t)((flags >> 8) & 0x01),
                (uint8_t)((flags >> 9) & 0x01));
  Serial.printf("    PatchDL_Error=%u Region0_CRC_Fail=%u Region1_CRC_Fail=%u PatchHeader_Error=%u\n",
                (uint8_t)((flags >> 10) & 0x01),
                (uint8_t)((flags >> 12) & 0x01),
                (uint8_t)((flags >> 13) & 0x01),
                (uint8_t)(flags & 0x01));
  Serial.printf("    DeadBattery=%u SystemTSD=%u\n",
                (uint8_t)((flags >> 2) & 0x01),
                (uint8_t)((flags >> 19) & 0x01));
}

static void printBqStatus() {
  uint8_t regs[7] = {0};
  for (uint8_t i = 0; i < 7; ++i) {
    if (!readBqReg((uint8_t)(0x1B + i), regs[i])) {
      Serial.printf("  read error (REG0x%02X)\n", (uint8_t)(0x1B + i));
      return;
    }
  }
  printBqStatusFromRegs(regs, sizeof(regs));

  uint16_t ibus = 0;
  uint16_t ibat = 0;
  uint16_t vbus = 0;
  uint16_t vac1 = 0;
  uint16_t vac2 = 0;
  uint16_t vbat = 0;
  uint16_t vsys = 0;
  if (readBqReg16(0x31, ibus) &&
      readBqReg16(0x33, ibat) &&
      readBqReg16(0x35, vbus) &&
      readBqReg16(0x37, vac1) &&
      readBqReg16(0x39, vac2) &&
      readBqReg16(0x3B, vbat) &&
      readBqReg16(0x3D, vsys)) {
    Serial.println("  ADC:");
    Serial.printf("    VBAT=%u mV VSYS=%u mV VBUS=%u mV VAC1=%u mV VAC2=%u mV\n",
                  vbat, vsys, vbus, vac1, vac2);
    Serial.printf("    IBAT=%u mA IBUS=%u mA\n", ibat, ibus);
  } else {
    Serial.println("  ADC: read error");
  }

  uint8_t reg2e = 0;
  uint8_t reg2f = 0;
  uint8_t reg30 = 0;
  if (readBqReg(0x2E, reg2e) && readBqReg(0x2F, reg2f) && readBqReg(0x30, reg30)) {
    Serial.printf("  ADC_CTRL: REG2E=0x%02X REG2F=0x%02X REG30=0x%02X\n", reg2e, reg2f, reg30);
    if ((reg2e & 0x80) == 0) {
      Serial.println("  ADC note: ADC_EN=0 (ADC disabled).");
    }
  }
}

static void printTpsStatus() {
  uint8_t buf[16] = {0};
  uint8_t actual = 0;

  Serial.printf("TPS25751 (0x%02X):\n", tpsAddr);

  if (readTpsRegister(0x03, buf, 4, actual) && actual >= 4) {
    char modeAscii[5] = {0};
    for (int i = 0; i < 4; ++i) {
      char c = (char)buf[i];
      modeAscii[i] = isprint((int)c) ? c : '.';
    }
    Serial.print("  MODE: ");
    printHexBytes(buf, 4);
    Serial.printf(" (\"%s\")\n", modeAscii);
  } else if (readTpsRegisterRaw(0x03, buf, 4)) {
    char modeAscii[5] = {0};
    for (int i = 0; i < 4; ++i) {
      char c = (char)buf[i];
      modeAscii[i] = isprint((int)c) ? c : '.';
    }
    Serial.print("  MODE: ");
    printHexBytes(buf, 4);
    Serial.printf(" (\"%s\")\n", modeAscii);
  } else {
    Serial.println("  MODE: read error");
  }

  // Boot flags are accessible even in BOOT/PTCH modes.
  printTpsBootFlags();

  if (readTpsRegister(0x1A, buf, 5, actual) && actual >= 5) {
    uint64_t status = leBytesToU64(buf, 5);
    Serial.print("  STATUS: ");
    printHexBytes(buf, 5);
    Serial.println();
    Serial.printf("    PlugPresent=%u ConnState=%s Orientation=%u PortRole=%s DataRole=%s\n",
                  (uint8_t)(status & 0x01),
                  tpsConnStateStr((status >> 1) & 0x07),
                  (uint8_t)((status >> 4) & 0x01),
                  ((status >> 5) & 0x01) ? "Source" : "Sink",
                  ((status >> 6) & 0x01) ? "DFP" : "UFP");
    Serial.printf("    VBUS=%s USBHost=%s Legacy=%s BIST=%u SoC_Timeout=%u\n",
                  tpsVbusStatusStr((status >> 20) & 0x03),
                  tpsUsbHostStr((status >> 22) & 0x03),
                  tpsLegacyStr((status >> 24) & 0x03),
                  (uint8_t)((status >> 27) & 0x01),
                  (uint8_t)((status >> 30) & 0x01));
  } else {
    Serial.println("  STATUS: read error");
  }

  if (readTpsRegister(0x3F, buf, 2, actual) && actual >= 2) {
    uint16_t pwr = (uint16_t)leBytesToU64(buf, 2);
    Serial.print("  POWER_STATUS: ");
    printHexBytes(buf, 2);
    Serial.println();
    Serial.printf("    PowerConn=%u SourceSink=%s TypeC_Current=%s\n",
                  pwr & 0x01,
                  ((pwr >> 1) & 0x01) ? "Source" : "Sink",
                  tpsTypecCurrentStr((pwr >> 2) & 0x03));
    Serial.printf("    ChargerDetect=%u ChargerAdvertise=%u\n",
                  (pwr >> 4) & 0x0F,
                  (pwr >> 8) & 0x03);
  } else {
    Serial.println("  POWER_STATUS: read error");
  }

  if (readTpsRegister(0x40, buf, 4, actual) && actual >= 4) {
    uint32_t pd = (uint32_t)leBytesToU64(buf, 4);
    Serial.print("  PD_STATUS: ");
    printHexBytes(buf, 4);
    Serial.println();
    Serial.printf("    PresentPDRole=%s PortType=%s CCPullup=%s\n",
                  ((pd >> 6) & 0x01) ? "Source" : "Sink",
                  tpsPortTypeStr((pd >> 4) & 0x03),
                  tpsCcPullupStr((pd >> 2) & 0x03));
    Serial.printf("    HardReset=%s SoftReset=%s\n",
                  tpsHardResetStr((pd >> 16) & 0x3F),
                  tpsSoftResetStr((pd >> 8) & 0x1F));
  } else {
    Serial.println("  PD_STATUS: read error");
  }

  if (readTpsRegister(0x69, buf, 4, actual) && actual >= 4) {
    uint32_t tc = (uint32_t)leBytesToU64(buf, 4);
    uint8_t portState = (tc >> 24) & 0xFF;
    uint8_t cc2 = (tc >> 16) & 0xFF;
    uint8_t cc1 = (tc >> 8) & 0xFF;
    uint8_t ccPd = tc & 0xFF;
    Serial.print("  TYPEC_STATE: ");
    printHexBytes(buf, 4);
    Serial.println();
    Serial.printf("    PortState=%s (0x%02X)\n", tpsTypecPortStateStr(portState), portState);
    Serial.printf("    CC1=%s CC2=%s PD_CC=%s\n",
                  tpsCcPinStateStr(cc1),
                  tpsCcPinStateStr(cc2),
                  tpsPdCcPinStr(ccPd));
  } else {
    Serial.println("  TYPEC_STATE: read error");
  }

  if (readTpsRegister(0x6A, buf, 13, actual) && actual >= 13) {
    Serial.print("  ADC_RESULTS: ");
    printHexBytes(buf, 13);
    Serial.println();
    const float v_adc = 0.014f;
    const float v_vbus = 0.098f;
    const float i_ivbus = 0.0165f;
    float adcin1 = buf[0] * v_adc;
    float adcin2 = buf[1] * v_adc;
    float ldo3v3 = buf[2] * v_adc;
    float vbus1 = buf[3] * v_vbus;
    float ivbus1 = buf[5] * i_ivbus;
    float ivbus1_mean = buf[11] * i_ivbus;
    Serial.printf("    ADCIN1=%.3fV ADCIN2=%.3fV LDO3V3=%.3fV VBUS1=%.3fV\n",
                  adcin1, adcin2, ldo3v3, vbus1);
    Serial.printf("    IVBUS1=%.3fA IVBUS1_MEAN=%.3fA\n", ivbus1, ivbus1_mean);
  } else {
    Serial.println("  ADC_RESULTS: read error");
  }
}

void setup() {
  Serial.begin(115200);
  delay(1500);

  Wire.begin(I2C_SDA_PIN, I2C_SCL_PIN, I2C_CLOCK_HZ);

  if (ENABLE_I2C_SCAN) {
    scanI2CBus();
  }

  if (AUTO_DETECT_TPS25751) {
    tpsPresent = false;
    for (size_t i = 0; i < sizeof(TPS25751_ADDR_CANDIDATES); ++i) {
      uint8_t addr = TPS25751_ADDR_CANDIDATES[i];
      if (probeAddress(addr)) {
        tpsAddr = addr;
        tpsPresent = true;
        break;
      }
    }
  } else {
    tpsPresent = probeAddress(tpsAddr);
  }

  bqPresent = probeAddress(BQ25792_ADDR);

  Serial.printf("TPS25751 %s at 0x%02X\n", tpsPresent ? "found" : "not found", tpsAddr);
  Serial.printf("BQ25792 %s at 0x%02X\n", bqPresent ? "found" : "not found", BQ25792_ADDR);
  if (ENABLE_LOW_REGION_PROVISION) {
    Serial.println("Provisioning: send 'P' over Serial to push low-region patch.");
  }
  Serial.println("Status output toggles: 'T' = TPS, 'B' = BQ (default off).");

  if (PROBE_EEPROM) {
    uint8_t buf[EEPROM_PROBE_LEN] = {0};
    if (probeAddress(EEPROM_ADDR) &&
        readEepromBytes(EEPROM_ADDR, EEPROM_PROBE_ADDR, buf, sizeof(buf))) {
      Serial.printf("EEPROM 0x%02X @0x%04X: ", EEPROM_ADDR, EEPROM_PROBE_ADDR);
      printHexBytes(buf, sizeof(buf));
      Serial.println();
    } else {
      Serial.printf("EEPROM 0x%02X: not detected/readable\n", EEPROM_ADDR);
    }
  }

  if (ENABLE_LOW_REGION_PROVISION && PROVISION_ON_BOOT) {
    provisionLowRegionPatch();
  }
}

void loop() {
  static uint32_t last = 0;
  if (ENABLE_LOW_REGION_PROVISION && Serial.available()) {
    char c = (char)Serial.read();
    if (c == 'P' || c == 'p') {
      provisionLowRegionPatch();
    }
    if (c == 'T' || c == 't') {
      printTpsUpdates = !printTpsUpdates;
      Serial.printf("TPS updates: %s\n", printTpsUpdates ? "ON" : "OFF");
    }
    if (c == 'B' || c == 'b') {
      printBqUpdates = !printBqUpdates;
      Serial.printf("BQ updates: %s\n", printBqUpdates ? "ON" : "OFF");
    }
    if (c == 'A' || c == 'a') {
      if (enableBqAdc()) {
        Serial.println("BQ ADC enabled.");
      } else {
        Serial.println("BQ ADC enable failed.");
      }
    }
    if (c == 'Q' || c == 'q') {
      uint8_t regs[7] = {0};
      if (readBqStatusViaTps(regs, sizeof(regs))) {
        Serial.println("---- BQ status via TPS ----");
        printBqStatusFromRegs(regs, sizeof(regs));
      }
    }
  }
  if (millis() - last < POLL_INTERVAL_MS) {
    delay(5);
    return;
  }
  last = millis();

  if (printTpsUpdates || printBqUpdates) {
    Serial.println();
    Serial.println("---- Charger/PD status ----");
  }

  if (printBqUpdates) {
    if (bqPresent) {
      printBqStatus();
    } else {
      Serial.println("BQ25792: not detected");
    }
  }

  if (printTpsUpdates) {
    if (tpsPresent) {
      printTpsStatus();
    } else {
      Serial.println("TPS25751: not detected");
    }
  }
}


